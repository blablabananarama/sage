## firmware/boards/shields/bayleaf/Kconfig.defconfig
```kconfig
# SPDX-License-Identifier: MIT

if SHIELD_BAYLEAF_LEFT

config ZMK_KEYBOARD_NAME
    default "Bayleaf"

config ZMK_SPLIT_ROLE_CENTRAL
    default y

endif

if SHIELD_BAYLEAF_LEFT || SHIELD_BAYLEAF_RIGHT

config ZMK_SPLIT
    default y

endif
```

## firmware/boards/shields/bayleaf/Kconfig.shield
```kconfig
# SPDX-License-Identifier: MIT

config SHIELD_BAYLEAF_LEFT
    def_bool $(shields_list_contains,bayleaf_left)

config SHIELD_BAYLEAF_RIGHT
    def_bool $(shields_list_contains,bayleaf_right)
```
